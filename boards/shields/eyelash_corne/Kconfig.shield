## boards/shields/eyelash_corne/Kconfig.shield
```kconfig
config SHIELD_EYESLASH_CORNE_CENTRAL_DONGLE
    def_bool $(shields_list_contains,eyeslash_corne_central_dongle)
```

## config/west.yml
```yaml
manifest:
  remotes:
    - name: zmkfirmware
      url-base: https://github.com/zmkfirmware
    - name: gpeye
      url-base: https://github.com/GPeye
    - name: englmaxi
      url-base: https://github.com/englmaxi
  projects:
    - name: eyelash_corne
      url: https://github.com/a741725193/zmk-new_corne
      revision: main
    - name: zmk
      remote: zmkfirmware
      revision: v0.3.0
      import: app/west.yml
    - name: hammerbeam-slideshow
      remote: gpeye
      revision: main
    - name: zmk-dongle-display
      remote: englmaxi
      revision: main
  self:
    path: config
```
